/* 文件名: TEST_61F14x_IO_INTERRUPT.c
* 功能：  FT61F14x_IO_INTERRUPT 功能演示
* IC:     FT61F145 TSSOP-20
* 内部：  16M/2T                                
* 说明：  外部PC1引脚电平变化中断使PB3输出0.625uS脉冲
*		   
*		   
*                FT61F145  TSSOP-20 
*              --------------------
* NC----------|1(PA5)   	(PA4)20|-----------NC     
* NC----------|2(PA6)   	(PA3)19|-----------NC
* NC----------|3(PA7)   	(PA2)18|-----------NC
* NC----------|4(PC0)   	(PA1)17|-----------NC
* DemoPortIn--|5(PC1)		(PA0)16|-----------NC	
* NC----------|6(PB7)		(PB0)15|-----------NC
* GND---------|7(GND)		(PB1)14|-----------NC
* NC----------|8(PB6)	    (PB2)13|-----------NC
* VDD-------- |9(VDD)	    (PB3)12|--DemoPortOut
* NC----------|10(PB5)      (PB4)11|-----------NC
*			   --------------------
*/
//*********************************************************
#include "SYSCFG.h"
//***********************宏定义****************************
#define  unchar     unsigned char 
#define  unint      unsigned int
#define  unlong     unsigned long

#define  DemoPortOut	PB3   
#define  DemoPortIn		PC1
/*-------------------------------------------------
* 函数名：interrupt ISR
* 功能：  输出脉冲
* 输入：  无
* 输出：  无
 --------------------------------------------------*/
void interrupt ISR(void)           
{ 
	if(EPIF0 & 0x02)                	
	{
		EPIF0 = 0x02;                   	//写1清零标志位 
                    
		DemoPortOut=1;
        NOP();
        NOP();
        NOP();
        NOP();
        NOP();
        DemoPortOut=0;
	} 
}  
/*-------------------------------------------------
* 函数名：POWER_INITIAL
* 功能：  上电系统初始化
* 输入：  无
* 输出：  无
 --------------------------------------------------*/	
void POWER_INITIAL (void) 
{
	OSCCON = 0B01110001;	//16MHz 1:1
	INTCON = 0;  			//暂禁止所有中断
    
	PORTA = 0B00000000;		
	TRISA = 0B00000000;		//PA输入输出 0-输出 1-输入
	PORTB = 0B00000000;		
	TRISB = 0B00000000;		//PB输入输出 0-输出 1-输入	PB3->输出
	PORTC = 0B00000000; 	
	TRISC = 0B00000010;		//PC输入输出 0-输出 1-输入  PC1->输入	

	
	WPUA = 0B00000000;     	//PA端口上拉控制 1-开上拉 0-关上拉
	WPUB = 0B00000000;     	//PB端口上拉控制 1-开上拉 0-关上拉
	WPUC = 0B00000010;     	//PC端口上拉控制 1-开上拉 0-关上拉 //PC1上拉
                            
    WPDA = 0B00000000;     	//PA端口下拉控制 1-开下拉 0-关下拉
	WPDB = 0B00000000;     	//PB端口下拉控制 1-开下拉 0-关下拉
	WPDC = 0B00000000;     	//PC端口下拉控制 1-开下拉 0-关下拉
    
    PSRC0  = 0B11111111;  	//PORTA,PORTB源电流设置最大
    PSRC1  = 0B11111111;    //PORTC,PORTD源电流设置最大    
    
    PSINK0 = 0B11111111;  	//PORTA灌电流设置最大 0:最小，1:最大
    PSINK1 = 0B11111111; 	//PORTB灌电流设置最大 0:最小，1:最大
    PSINK2 = 0B11111111;	//PORTC灌电流设置最大 0:最小，1:最大
	
    ANSELA = 0B00000000;    //全为数字管脚
}
/*------------------------------------------------- 
* 函数名称：DelayUs
* 功能：    短延时函数 --16M-2T--大概快1%左右.
* 输入参数：Time延时时间长度 延时时长Time Us
* 返回参数：无 
 -------------------------------------------------*/
void DelayUs(unsigned char Time)
{
	unsigned char a;
	for(a=0;a<Time;a++)
	{
		NOP();
	}
}                  
/*-------------------------------------------------
* 函数名称：DelayMs
* 功能：    短延时函数 快1%
* 输入参数：Time延时时间长度 延时时长Time ms
* 返回参数：无 
 -------------------------------------------------*/
void DelayMs(unsigned char Time)
{
	unsigned char a,b;
	for(a=0;a<Time;a++)
	{
		for(b=0;b<5;b++)
		{
		 	DelayUs(197);
		}
	}
}
/*-------------------------------------------------
* 函数名称：DelayS
* 功能：    短延时函数
* 输入参数：Time延时时间长度 延时时长Time S
* 返回参数：无 
 -------------------------------------------------*/
void DelayS(unsigned char Time)
{
	unsigned char a,b;
	for(a=0;a<Time;a++)
	{
		for(b=0;b<10;b++)
		{
		 	DelayMs(100); 
		}
	}
}
/*-------------------------------------------------
* 函数名：IO_INT_INITIAL
* 功能：  管脚中断设置
* 输入：  无
* 输出：  无
 --------------------------------------------------*/
void IO_INT_INITIAL(void)
{
	EPS0=0B00001000; 	//选择PC1管脚中断,EINT1
    //Px0~Px3中断管脚选择
    EPS1=0B00000000;
    //Px4~Px7中断管脚选择
    
    ITYPE0 = 0B00001100;//控制PC1中断类型：双边沿
    ITYPE1 = 0B00000000;
    
    EPIE0  = 0B00000010; //允许外部管脚EINT1中断
    
    INTCON = 0B11000000; //GIE,PEIE使能
}
/*-------------------------------------------------
* 函数名：main 
* 功能：  主函数
* 输入：  无
* 输出：  无
 --------------------------------------------------*/
void main(void)
{
	POWER_INITIAL();		//系统初始化
    IO_INT_INITIAL();
    
	while(1)
	{
		NOP();
    }
}