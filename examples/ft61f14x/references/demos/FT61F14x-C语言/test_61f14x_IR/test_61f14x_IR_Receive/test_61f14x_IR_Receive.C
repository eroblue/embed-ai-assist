//********************************************************* 
/* 文件名：TEST_61F14x_IR_Receive.c
* 功能:    FT61F14X_IR_Receive红外接收 功能演示
* IC:      FT61F145 TSSOP-20
* 内部：   16M/2T
* 说明：   演示程序中,IR红外是采用6122协议，起始信号是9ms低电平，到4.5ms高电平，再到低8位
*          用户识别码，到高8位的用户识别码，8位数据码，8位数据码的反码。RXIO（RC1）每次收到
*          遥控器发过来的数据后，数据是合法（两对补码，不对内容判断）的话，LED(RB3)开关状
*		   态就改变一次。
*
*                FT61F145  TSSOP-20 
*              ---------------------
* NC----------|1(PA5)   	(PA4)20|-----------NC     
* NC----------|2(PA6)   	(PA3)19|-----------NC
* NC----------|3(PA7)   	(PA2)18|-----------NC
* NC----------|4(PC0)   	(PA1)17|-----------NC
* IRRIO-------|5(PC1)		(PA0)16|-----------NC	
* NC----------|6(PB7)		(PB0)15|-----------NC
* GND---------|7(GND)		(PB1)14|-----------NC
* NC----------|8(PB6)	    (PB2)13|-----------NC
* VDD-------- |9(VDD)	    (PB3)12|----------LED
* NC----------|10(PB5)      (PB4)11|-----------NC
*			   ----------------------
*/
//*********************************************************
#include	"SYSCFG.h"
//**********************宏定义*****************************
#define  uchar	unsigned char 

#define  IRRIO	PC1  		//IR的接收脚
#define  LED	PB3			//LED指示灯的IO

uchar IRbitNum = 0;		    //用于记录接收到第几位数据了
uchar IRbitTime = 0;		//用于计时一位的时间长短
volatile uchar IRDataTimer[4];//存出来的4个数据
uchar bitdata=0x01;			//用于按位或的位数据
uchar ReceiveFinish = 0;	//用于记录接收完成
uchar ReadAPin = 0;			//用于读取IO口状态，电平变化中断标志清除
volatile uchar rdata1,rdata2;
/*-------------------------------------------------
* 函数名：POWER_INITIAL 
* 功能：  MCU初始化函数
* 输入：  无
* 输出：  无
 --------------------------------------------------*/
void POWER_INITIAL(void)
{
	OSCCON = 0B01110001;	//16MHz 1:1
	INTCON = 0;  			//暂禁止所有中断
    
	PORTA = 0B00000000;		
	TRISA = 0B00000000;		//PA输入输出 0-输出 1-输入
	PORTB = 0B00000000;		
	TRISB = 0B00000000;		//PB输入输出 0-输出 1-输入	PB3->输出						
	PORTC = 0B00000000; 	
	TRISC = 0B00000010;		//PC输入输出 0-输出 1-输入  PC1->输入
	
	WPUA = 0B00000000;     	//PA端口上拉控制 1-开上拉 0-关上拉
	WPUB = 0B00000000;     	//PB端口上拉控制 1-开上拉 0-关上拉
	WPUC = 0B00000010;     	//PC端口上拉控制 1-开上拉 0-关上拉 PC1->上拉
    
    WPDA = 0B00000000;     	//PA端口上拉控制 1-开下拉 0-关下拉
	WPDB = 0B00000000;     	//PB端口上拉控制 1-开下拉 0-关下拉
	WPDC = 0B00000000;     	//PC端口上拉控制 1-开下拉 0-关下拉
    
    PSRC0  = 0B11111111;  	//PORTA,PORTB源电流设置最大
    PSRC1  = 0B11111111;    //PORTC,PORTD源电流设置最大    
    
    PSINK0 = 0B11111111;  	//PORTA灌电流设置最大 0:最小，1:最大
    PSINK1 = 0B11111111; 	//PORTB灌电流设置最大 0:最小，1:最大
    PSINK2 = 0B11111111;	//PORTC灌电流设置最大 0:最小，1:最大
	
    ANSELA = 0B00000000;    //全为数字管脚
}
/*----------------------------------------------------
* 函数名称：TIMER4_INITIAL
* 功能：初始化设置定时器4
* 设置TMR4定时时长560us                     
 ----------------------------------------------------*/
void TIMER4_INITIAL (void)  
{
	PCKEN |=0B00001000;      //TIME4模块时钟使能

    TIM4CR1	=0B00000101;
	//Bit7: 自动预装载允许位
	//0：TIM4_ARR寄存器没有缓冲，它可以被直接写入；
	//1：TIM4_ARR寄存器由预装载缓冲器缓冲。
    
    //Bit6: 保留
    
    //Bit[5:4]:timer4时钟选择位。
	//00：系统时钟/主时钟
	//01：内部快时钟HIRC
	//10：LP时钟，只有当FOSC选择LP模式时才有意义
	//11：XT时钟，只有当FOSC选择XT模式时才有意义

    //Bit3:单脉冲模式
	//0：在发生更新事件时，计数器不停止；
	//1：在发生下一次更新事件(清除CEN位)时，计数器停止。

    //Bit2:更新请求源
	//0：如果UDIS允许产生更新事件，则下述任一事件产生一个更新中断：
	//寄存器被更新(计数器上溢/下溢)
	//软件设置UG位
	//时钟/触发控制器产生的更新
	//1：如果UDIS允许产生更新事件，则只有当下列事件发生时才产生更新中断，并UIF置1：
	//寄存器被更新(计数器上溢/下溢)

    //Bit1:停止更新
	//0：一旦下列事件发生，产生更新(UEV)事件：
	//计数器溢出/下溢
	//产生软件更新事件
	//时钟/触发模式控制器产生的硬件复位被缓存的寄存器被装入它们的预装载值。
	//1：不产生更新事件，影子寄存器(ARR、PSC、CCRx)保持它们的值。如果设置了UG位或时钟/触发控制器发出了一个硬件复位，则计数器和预分频器被重新初始化。

    // Bit0: 允许计数器
    //0：禁止计数器；
    //1：使能计数器。


    TIM4IER	=0B00000001;
    //Bit0:允许更新中断
    //0：禁止更新中断
    //1：允许更新中断

    TIM4SR	=0B00000000;
    //Bit0:当产生更新事件时该位由硬件置1。它由软件写1清0
	//0：无更新事件产生；
	//1：更新事件等待响应。当寄存器被更新时该位由硬件置1：
	//若TIM4_CR1寄存器的UDIS=0，当计数器上溢或下溢时；
	//若TIM4_CR1寄存器的UDIS=0、URS=0，当设置TIM4_EGR寄存器的UG位软件对计数器
	//CNT重新初始化时；
	//若TIM4_CR1寄存器的UDIS=0、URS=0，当计数器CNT被触发事件重新初始化时。

    TIM4EGR	=0B00000000;
    //Bit0:该位由软件置1，由硬件自动清0。
	//0：无动作；
	//1：重新初始化计数器，并产生一个更新事件。
    //注意预分频器的计数器也被清0(但是预分频系数不变)。
    //若在中心对称模式下或DIR=0(向上计数)则计数器被清0；
    //若DIR=1(向下计数)则计数器取TIM1_ARR的值。

    TIM4CNTR=0; //TIM4 8位计数器
    
    TIM4PSCR=0B00000110;
    //预分频器对输入的CK_PSC时钟进行分频。
	//计数器的时钟频率fCK_CNT等于fCK_PSC/2(PSC[2:0])。PSC[7:3]由硬件清0。
	//PSCR包含了当更新事件产生时装入当前预分频器寄存器的值
    //(包括由于清除TIMx_EGR寄存器的UG位产生的计数器清除事件)。
    //这意味着如要新的预分频值生效，必须产生更新事件或者CEN=0。

    TIM4ARR	=140;
    //ARR包含了将要装载入实际的自动重装载寄存器的值。
	//当自动重装载的值为空时，计数器不工作。
}
/*-------------------------------------------------
* 函数名: Px_Level_Change_INITIAL
* 功能：  端口电平变化中断初始化
* 输入：  无
* 输出：  无
--------------------------------------------------*/
void Px_Level_Change_INITIAL(void)
{
	EPS0=0B10000000; 			//选择PC3管脚中断
    //Px0~Px3中断管脚选择
    EPS1=0B00000000;
    //Px4~Px7中断管脚选择
    
    ITYPE0 = 0B11000000;		//双沿中断
    ITYPE1 = 0B00000000;
    
    EPIE0  = 0B00001000;		//使能中断3
    
    INTCON = 0B01000000;
}
/*-------------------------------------------------
* 函数名：interrupt ISR
* 功能：  中断处理，包括定时器0中断和外部中断
* 输入：  无
* 输出：  无
 --------------------------------------------------*/
void interrupt ISR(void)   
{ 
	//定时器4的中断处
	if(T4UIE && T4UIF)                	
	{
		T4UIF = 1;				//写1清零标志位  
         
		IRbitTime++;
        if(IRbitTime > 50)
        {
        	T4UIE = 0;
            IRbitTime = 0;
        }
	} 
    
    //Px电平变化中
	if(EPIF0 & 0x08)                	
	{
		EPIF0 |= 0x08;			//写1清零标志位 
        
        if(IRRIO == 0)
        {
        	T4UIE = 1;
        	if(IRbitTime > 21)
            {
            	IRDataTimer[0] = 0;
                IRDataTimer[1] = 0;
                IRDataTimer[2] = 0;
                IRDataTimer[3] = 0;
                IRbitNum = 0;
                bitdata = 0x00;
            }
            else if(IRbitTime > 3)
            {
            	IRDataTimer[IRbitNum-1] |= bitdata;
            }
            IRbitTime = 0;
            bitdata<<=1;
            if(bitdata == 0)
            {
            	bitdata = 0x01;
                IRbitNum++;
            }
            if(IRbitNum > 4)
            {
            	IRbitNum = 0;
                T4UIE = 0;  
                ReceiveFinish = 1;		
            }
        }
	}
} 
/*-------------------------------------------------
* 函数名：main
* 功能：  主函数
* 输入：  无
* 输出：  无
 --------------------------------------------------*/
void main(void)
{
	POWER_INITIAL();
    TIMER4_INITIAL();
    Px_Level_Change_INITIAL();
    GIE = 1; 						//开中断
  				
    while(1)
    {
		if(ReceiveFinish==1)
        {
        	ReceiveFinish = 0;
            rdata1 = 0xFF - IRDataTimer[0];
            rdata2 = 0xFF - IRDataTimer[2];
            if((rdata1 == IRDataTimer[1])&&(rdata2 == IRDataTimer[3]))
            {
            	LED = ~LED; 		//翻转电平
            }
        }
    }
}
