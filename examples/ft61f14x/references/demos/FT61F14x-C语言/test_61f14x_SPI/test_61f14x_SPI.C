//********************************************************* 
/* 文件名: TEST_61F14x_SPI.c
* 功能：   FT61F14x-SPI功能演示
* IC:      FT61F145 TSSOP-20
* 内部：   16M/2T                                     
* 说明：   此演示程序为61F14x_SPI的演示程序.
*		   该程序读取(25C64)0x12地址的值,取反后存入0x13地址  
*		  
*                FT61F145  TSSOP-20 
*              ---------------------
* NC----------|1(PA5)   	(PA4)20|-----------NC     
* NC----------|2(PA6)   	(PA3)19|-----------NC
* NC----------|3(PA7)   	(PA2)18|-----------NC
* NC----------|4(PC0)   	(PA1)17|-----------NC
* NC----------|5(PC1)		(PA0)16|-----------NC	
* NC----------|6(PB7)		(PB0)15|-----------CS
* GND---------|7(GND)		(PB1)14|-----------NC
* NC----------|8(PB6)	    (PB2)13|---------MOSI
* VDD-------- |9(VDD)	    (PB3)12|-----------NC
* SCK---------|10(PB5)      (PB4)11|---------MISO
*			   ----------------------
*/
//*********************************************************
#include "SYSCFG.h"
//***********************宏定义****************************
#define  unchar     unsigned char 
#define  unint      unsigned int

#define  MISO			PB4   
#define  MOSI			PB2
#define  SCK			PB5   
#define  CS				PB0 

volatile unchar 	SPIReadData=0;
/*-------------------------------------------------
* 函数名：POWER_INITIAL
* 功能：  上电系统初始化
* 输入：  无
* 输出：  无
 --------------------------------------------------*/	
void POWER_INITIAL (void) 
{ 
	OSCCON = 0B01110001;	//16MHz 1:1
	INTCON = 0;  			//暂禁止所有中断
    
	PORTA = 0B00000000;		
	TRISA = 0B00000000;		//PA输入输出 0-输出 1-输入
	PORTB = 0B00000000;		
	TRISB = 0B00010000;		//PB输入输出 0-输出 1-输入，PB4输入						
	PORTC = 0B00000000; 	
	TRISC = 0B00000000;		//PC输入输出 0-输出 1-输入  	
	
	WPUA = 0B00000000;     	//PA端口上拉控制 1-开上拉 0-关上拉
	WPUB = 0B00010000;     	//PB端口上拉控制 1-开上拉 0-关上拉 PB4->输入
	WPUC = 0B00000000;     	//PC端口上拉控制 1-开上拉 0-关上拉
    
    WPDA = 0B00000000;     	//PA端口下拉控制 1-开下拉 0-关下拉
	WPDB = 0B00000000;     	//PB端口下拉控制 1-开下拉 0-关下拉
	WPDC = 0B00000000;     	//PC端口下拉控制 1-开下拉 0-关下拉
    
    PSRC0 = 0B11111111;  	//PORTA,PORTB源电流设置最大
    PSRC1 = 0B11111111;    	//PORTC,PORTD源电流设置最大    
    
    PSINK0 = 0B11111111;  	//PORTA灌电流设置最大 0:最小，1:最大
    PSINK1 = 0B11111111; 	//PORTB灌电流设置最大 0:最小，1:最大
    PSINK2 = 0B11111111;	//PORTC灌电流设置最大 0:最小，1:最大
	
    ANSELA = 0B00000000;    //全为数字管脚
}
/*-------------------------------------------------
* 函数名：init_25c64_io
* 功能：  25C64初始化
* 输入：  无
* 输出：  无
 --------------------------------------------------*/	
void init_25c64_io(void)
{
    CS = 1;
 	SCK = 0;
    MOSI = 0;
}
/*-------------------------------------------------
* 函数名：SPI_RW
* 功能：  主机输出以及输入一个字节
* 输入：  data
* 输出：  根据接收的data输出给从机一个字节
 --------------------------------------------------*/		  
unchar SPI_RW(unchar data)
{
   unchar i; 
   for(i=0;i<8;i++)
   {
    if(data&0x80)
      MOSI = 1;                  //输出 'uchar' MSB 到 MOSI
    else
      MOSI = 0;
    NOP();
    data<<=1;                    //下一比特转到MSB
    SCK = 1;                     //SCK置高
	NOP();
    if(MISO)
      data |= 0x01;
    else
      data &= 0xFE;
		NOP();
    SCK = 0;
   }
   return data;
 }
/*-------------------------------------------------
* 函数名：WriteEnable
* 功能：  写允许（将WEN置位） 
 --------------------------------------------------*/
void WriteEnable(void)
{
    CS=0;
    SPI_RW(0x06);  
    CS=1;
}
/*-------------------------------------------------
* 函数名：WriteDisable
* 功能：  写禁止（将WEN复位） 
 --------------------------------------------------*/
 void WriteDisable (void)
{
    CS=0;
    SPI_RW(0x04);  
    CS=1;
}
/*-------------------------------------------------
* 程序名：SPI_ReadStatus
* 功能：读取25C64芯片的状态。
* 返回值：状态寄存器数据字节
* 注：25C64内部状态寄存器第0位=0表示空闲，0位=1表示忙。
 --------------------------------------------------*/
unchar SPI_ReadStatus(void)
{
    unchar status=0;
    CS=0;
    SPI_RW(0x05);                //0x05读取状态的命令字
    status = SPI_RW(0x00);        
    CS=1;                        //关闭片选
    return status;
}  
/*-------------------------------------------------
* 程序名：SPI_WriteStatus
* 功能:   写25C64芯片的状态寄存器。
*         只有BP1、BP0 (bit7、3、2)可以写、
* 注：    25c64内部状态寄存器第0位=0表示空闲，0位=1表示忙。
 --------------------------------------------------*/
void SPI_WriteStatus(unchar Status)
{
    CS=0;
    SPI_RW(0X01);  		          //0x01读取状态的命令字
    SPI_RW(Status);               //写入一个字节
    CS=1;                         //关闭片选
}
/*-------------------------------------------------
* 程序名：SPI_Read
* 输入: 16位的地址
* 返回: 读取的数据
* 说明：从25c64指定的地址读取一个字节
 --------------------------------------------------*/
unchar SPI_Read(unint addr)
{
	unchar spidata;
    while(SPI_ReadStatus()&0x01);        //判断是否忙
    CS=0;                                //使能器件   
    SPI_RW(0x03);                        //发送读取命令   
    SPI_RW((unsigned char)((addr)>>8));
    SPI_RW((unsigned char)addr);
  	spidata = SPI_RW(0x00);              //读出数据  
    CS=1;  
  	return spidata;            
}
/*-------------------------------------------------
* 程序名：SPI_Write
* 输入: 地址，字节数据
* 说明：将一个字节写入指定的地址
 --------------------------------------------------*/
void SPI_Write(unint addr,unchar dat)
{
    while(SPI_ReadStatus()&0x01);        //判断是否忙
    WriteEnable();                       //使能器件   
    CS=0;                                //发送写命令 
    SPI_RW(0x02);
    SPI_RW((unchar)((addr)>>8));
    SPI_RW((unchar)addr);
    
    SPI_RW(dat);
    CS=1;                                //关闭片选
	WriteDisable(); 
    while(SPI_ReadStatus()&0x01); 
}
/*-------------------------------------------------
* 函数名: main 
* 功能：  主函数
* 输入：  无
* 输出：  无
 --------------------------------------------------*/
void main(void)
{
	SPIReadData=0;
	POWER_INITIAL();						//系统初始化
	init_25c64_io();
	SPIReadData = SPI_Read(0x12); 			//读取0x12地址EEPROM值 
	SPI_Write(0x13,~SPIReadData); 			//取反写入地址0x13
    
	while(1)
	{
    	NOP();
	}
}